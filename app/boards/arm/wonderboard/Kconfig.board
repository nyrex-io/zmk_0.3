## app/boards/arm/wonderboard/Kconfig.board
```kconfig
config BOARD_WONDERBOARD
    bool "wonderboard"
    depends on SOC_NRF52840_QIAA
```

## app/boards/arm/wonderboard/Kconfig.defconfig
```kconfig
if BOARD_WONDERBOARD

config BOARD
    default "wonderboard"

if USB_DEVICE_STACK

config USB_NRFX
    default y

endif # USB_DEVICE_STACK

config BT_CTLR
    default BT

endif #BOARD_WONDERBOARD
```

## app/boards/shields/nyrex65x2/Kconfig.defconfig
```kconfig
if SHIELD_NYREX65X2

config ZMK_KEYBOARD_NAME
    default "Nyrex 65X2"

config ZMK_SPLIT_ROLE_CENTRAL
    default y

config ZMK_SPLIT_BLE_CENTRAL_BATTERY_LEVEL_PROXY
    default y

config ZMK_SPLIT_BLE_CENTRAL_BATTERY_LEVEL_FETCHING
    default y

endif

if SHIELD_CORNE_LEFT || SHIELD_CORNE_RIGHT

config ZMK_SPLIT
    default y

config ZMK_STUDIO
    default y

endif
```

## app/boards/shields/nyrex65x2/Kconfig.shield
```kconfig
config SHIELD_NYREX65X2
    def_bool $(shields_list_contains,nyrex65x2_left)

config SHIELD_NYREX65X2
    def_bool $(shields_list_contains,nyrex65x2_right)
```
